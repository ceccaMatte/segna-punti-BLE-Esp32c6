## main/Kconfig.projbuild
```kconfig
menu "Playmaker wearable"

config WEARABLE_BUTTON_ACTIVE_LOW
    bool "Buttons are active low"
    default y

config WEARABLE_CHARGE_LED_GPIO
    int "Charge status LED GPIO (-1 disables)"
    default -1

config WEARABLE_CHARGER_STAT_ADC_CHANNEL
    int "ADC1 channel connected to MCP73831 STAT divider"
    range 0 4
    default 4
    help
        Prototype: MCP73831 STAT divider -> ESP32-C3 GPIO4 / ADC1_CH4.

config WEARABLE_CHARGER_STAT_HIGH_RAW
    int "ADC raw threshold: STAT HIGH / charge complete"
    range 1 4094
    default 1000
    help
        STAT is approximately 0 V while charging and approximately 2.5 V at
        battery_state when MCP73831 drives STAT HIGH.

config WEARABLE_VBUS_SENSE_GPIO
    int "5V/VBUS-present GPIO (-1 if unavailable)"
    default -1
    help
        Needed to distinguish MCP73831 STAT LOW (charging) from STAT High-Z
        (charger unpowered).

config WEARABLE_VBUS_SENSE_ACTIVE_HIGH
    bool "VBUS sense is active high"
    default y

config WEARABLE_BATTERY_VOLTAGE_ADC_CHANNEL
    int "ADC1 channel for a dedicated Vbat divider (-1 if unavailable)"
    range -1 4
    default -1

config WEARABLE_BATTERY_DIVIDER_NUM
    int "Vbat divider numerator"
    default 1
config WEARABLE_BATTERY_DIVIDER_DEN
    int "Vbat divider denominator"
    default 1
config WEARABLE_LOW_BATTERY_MV
    int "Low battery threshold (mV)"
    default 3300
config WEARABLE_LOW_BATTERY_BEEP_MS
    int "Low battery reminder period (ms)"
    default 20000

config WEARABLE_PAIRING_WINDOW_MS
    int "Pairing window (ms)"
    default 120000

endmenu
```

## receiver/sdkconfig.defaults
```kconfig
CONFIG_IDF_TARGET="esp32c3"
CONFIG_BT_ENABLED=n
CONFIG_CJSON_NESTING_LIMIT=16
CONFIG_ESP_CONSOLE_NONE=y
CONFIG_ESP_CONSOLE_SECONDARY_NONE=y
CONFIG_LOG_DEFAULT_LEVEL_NONE=y
CONFIG_LOG_MAXIMUM_LEVEL=0
CONFIG_BOOTLOADER_LOG_LEVEL_NONE=y
CONFIG_FREERTOS_HZ=1000
CONFIG_ESP_MAIN_TASK_STACK_SIZE=8192
CONFIG_ESPTOOLPY_FLASHSIZE_4MB=y
CONFIG_ESPTOOLPY_FLASHSIZE="4MB"
CONFIG_PARTITION_TABLE_CUSTOM=y
CONFIG_PARTITION_TABLE_CUSTOM_FILENAME="partitions.csv"
CONFIG_PARTITION_TABLE_FILENAME="partitions.csv"
```
